## generator/config/stage/sample.yaml
```yaml
# $schema: ../schema.json
name: $sample
link: https://www.mongodb.com/docs/manual/reference/operator/aggregation/sample/
type:
    - stage
encode: object
description: |
    Randomly selects the specified number of documents from its input.
arguments:
    - name: size
      type:
          - int
      description: |
          The number of documents to randomly select.
tests:
    - name: Example
      link: https://www.mongodb.com/docs/manual/reference/operator/aggregation/sample/#examples
      pipeline:
          - $sample:
                size: 3
      schema:
          users:
              _id:
                  types:
                      - bsonType: Number
              name:
                  types:
                      - bsonType: String
              q1:
                  types:
                      - bsonType: Boolean
              q2:
                  types:
                      - bsonType: Boolean
```
